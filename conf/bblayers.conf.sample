## conf/bblayers.conf.sample
```bitbake
POKY_BBLAYERS_CONF_VERSION = "2" 
BBPATH = "${TOPDIR}"
BBFILES ?= "" 
BBLAYERS ?= " \ 
/home/reinhard/Develop/oe_yocto/dunfell_demo/layers/poky/meta \
/home/reinhard/Develop/oe_yocto/dunfell_demo/layers/poky/meta-poky \
/home/reinhard/Develop/oe_yocto/dunfell_demo/layers/poky/meta-yocto-bsp \
/home/reinhard/Develop/oe_yocto/dunfell_demo/layers/meta-openembedded/meta-oe \
/home/reinhard/Develop/oe_yocto/dunfell_demo/layers/meta-openembedded/meta-python \
/home/reinhard/Develop/oe_yocto/dunfell_demo/layers/meta-openembedded/meta-networking \
"

BBLAYERS_NON_REMOVABLE ?= " \ 
  ##OEROOT##/meta \ 
"
```

## layers/meta/conf/layer.conf
```bitbake
# We might have a conf and classes directory, append to BBPATH
BBPATH .= ":${LAYERDIR}"

# We have recipes directories, add to BBFILES
BBFILES += "${LAYERDIR}/recipes*/*/*.bb ${LAYERDIR}/recipes*/*/*.bbappend"

BBFILE_COLLECTIONS += "meta-ext"
BBFILE_PATTERN_meta-ext := "^${LAYERDIR}/"
BBFILE_PRIORITY_meta-ext = "7"

# This should only be incremented on significant changes that will
# cause compatibility issues with other layers
LAYERVERSION_meta-ext = "1"

LAYERDEPENDS_meta-ext = "core openembedded-layer"

LAYERSERIES_COMPAT_meta-ext = "thud warrior zeus dunfell"

LICENSE_PATH += "${LAYERDIR}/licenses"
```
